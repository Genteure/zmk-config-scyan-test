#include "three_parts-layouts.dtsi"
#include <dt-bindings/zmk/matrix_transform.h>

/ {
    matrix_transform0: matrix_transform0 {
        compatible = "zmk,matrix-transform";
        columns = <1>;
        rows = <3>;
        map = <
            RC(0,0) RC(1,0) RC(2,0)
        >;
    };
};

&physical_layout_three_parts {
    transform = <&matrix_transform0>;
};

